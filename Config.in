## Config.in
```kconfig
menu "Anyka firmware"

source "$BR2_EXTERNAL_ANYKA_PATH/Config.soc.in"

menu "Packages"

source "$BR2_EXTERNAL_ANYKA_PATH/package/anyka-libs/Config.in"
source "$BR2_EXTERNAL_ANYKA_PATH/package/anyka-modules/Config.in"
source "$BR2_EXTERNAL_ANYKA_PATH/package/ipcd/Config.in"

endmenu

endmenu
```

## configs/gncc_gk2_defconfig
```kconfig
BR2_arm=y
BR2_TOOLCHAIN_EXTERNAL=y
BR2_TOOLCHAIN_EXTERNAL_CUSTOM=y
BR2_TOOLCHAIN_EXTERNAL_PATH="/path/to/tuya-bsp-gpl-public-components/arm-anykav500-linux-uclibcgnueabi/arm-anykav500-linux-uclibcgnueabi"
BR2_TOOLCHAIN_EXTERNAL_CUSTOM_PREFIX="arm-anykav500-linux-uclibcgnueabi"
BR2_TOOLCHAIN_EXTERNAL_GCC_4_9=y
BR2_TOOLCHAIN_EXTERNAL_HEADERS_4_4=y
BR2_TOOLCHAIN_EXTERNAL_WCHAR=y
# BR2_TOOLCHAIN_EXTERNAL_HAS_THREADS_DEBUG is not set
BR2_TOOLCHAIN_EXTERNAL_CXX=y
BR2_TARGET_GENERIC_ROOT_PASSWD=""
BR2_ROOTFS_OVERLAY="$(BR2_EXTERNAL_ANYKA_PATH)/board/anyka/rootfs-overlay"
BR2_ROOTFS_POST_BUILD_SCRIPT="$(BR2_EXTERNAL_ANYKA_PATH)/board/anyka/post-build.sh"
BR2_ROOTFS_POST_FAKEROOT_SCRIPT="$(BR2_EXTERNAL_ANYKA_PATH)/board/anyka/post-fakeroot.sh"
BR2_ROOTFS_POST_IMAGE_SCRIPT="$(BR2_EXTERNAL_ANYKA_PATH)/board/anyka/post-image.sh"
BR2_LINUX_KERNEL=y
BR2_LINUX_KERNEL_CUSTOM_TARBALL=y
BR2_LINUX_KERNEL_CUSTOM_TARBALL_LOCATION="file://$(BR2_EXTERNAL_ANYKA_PATH)/dl/linux-ak-4.4.192.tar.gz"
BR2_LINUX_KERNEL_USE_CUSTOM_CONFIG=y
BR2_LINUX_KERNEL_CUSTOM_CONFIG_FILE="$(BR2_EXTERNAL_ANYKA_PATH)/board/anyka/linux.config"
BR2_LINUX_KERNEL_UIMAGE=y
BR2_LINUX_KERNEL_XZ=y
BR2_LINUX_KERNEL_UIMAGE_LOADADDR="0x80008000"
# BR2_PACKAGE_LIBOPENSSL_ENABLE_MD2 is not set
# BR2_PACKAGE_LIBOPENSSL_ENABLE_MDC2 is not set
# BR2_PACKAGE_LIBOPENSSL_ENABLE_IDEA is not set
# BR2_PACKAGE_LIBOPENSSL_ENABLE_SEED is not set
# BR2_PACKAGE_LIBOPENSSL_ENABLE_WHIRLPOOL is not set
# BR2_PACKAGE_LIBOPENSSL_ENABLE_SSL3 is not set
# BR2_PACKAGE_LIBOPENSSL_ENABLE_WEAK_SSL is not set
# BR2_PACKAGE_LIBOPENSSL_ENABLE_CAST is not set
# BR2_PACKAGE_LIBOPENSSL_ENABLE_COMP is not set
# BR2_PACKAGE_LIBOPENSSL_ENABLE_CMP is not set
# BR2_PACKAGE_LIBOPENSSL_ENABLE_LOADER_ENGINE is not set
# BR2_PACKAGE_LIBOPENSSL_ENABLE_PADLOCK_ENGINE is not set
# BR2_PACKAGE_LIBOPENSSL_ENABLE_QUIC is not set
# BR2_PACKAGE_LIBOPENSSL_ENABLE_SSL_TRACE is not set
BR2_PACKAGE_DROPBEAR=y
BR2_PACKAGE_HOSTAPD=y
BR2_PACKAGE_WPA_SUPPLICANT=y
BR2_PACKAGE_WPA_SUPPLICANT_WPA3=y
BR2_PACKAGE_WPA_SUPPLICANT_CLI=y
BR2_TARGET_ROOTFS_SQUASHFS=y
BR2_TARGET_ROOTFS_SQUASHFS4_XZ=y
# BR2_TARGET_ROOTFS_TAR is not set
BR2_PACKAGE_IPCD=y
```

## package/anyka-libs/Config.in
```kconfig
config BR2_PACKAGE_ANYKA_LIBS
	bool "anyka-libs"
	help
	  Proprietary Anyka SDK shared libraries and ISP config.
```

## package/anyka-modules/Config.in
```kconfig
config BR2_PACKAGE_ANYKA_MODULES
	bool "anyka-modules"
	help
	  Stock GK2 kernel modules (SD, ISP, F37P sensor, audio, wifi, motor).
```

## package/ipcd/Config.in
```kconfig
config BR2_PACKAGE_IPCD
	bool "Anyka IPCD"
	select BR2_PACKAGE_ANYKA_LIBS
	select BR2_PACKAGE_ANYKA_MODULES
	help
	  GNCC GK2 IPC daemon with ONVIF, RTSP, PTZ and day/night support.
```
